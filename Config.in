## configs/baltos_experimental_defconfig
```kconfig
BR2_arm=y
BR2_cortex_a8=y
BR2_KERNEL_MIRROR="https://www.kernel.org/pub"
BR2_GNU_MIRROR="http://ftp.gnu.org/pub/gnu"
# BR2_COMPILER_PARANOID_UNSAFE_PATH is not set
BR2_TOOLCHAIN_EXTERNAL=y
BR2_ROOTFS_DEVICE_CREATION_DYNAMIC_EUDEV=y
BR2_TARGET_GENERIC_ROOT_PASSWD="linux"
BR2_ENABLE_LOCALE_WHITELIST="C"
BR2_ROOTFS_OVERLAY="$(BR2_EXTERNAL_ONRISC_BSP_PATH)/board/vscom/baltos/fs-overlay/ $(BR2_EXTERNAL_ONRISC_BSP_PATH)/board/vscom/baltos/fs-overlay-experimental/"
BR2_ROOTFS_POST_IMAGE_SCRIPT="$(BR2_EXTERNAL_ONRISC_BSP_PATH)/board/vscom/baltos/custom-FIT-intree.sh $(BR2_EXTERNAL_ONRISC_BSP_PATH)/board/vscom/scripts/modules.sh $(BR2_EXTERNAL_ONRISC_BSP_PATH)/board/vscom/baltos/post-image-barebox.sh"
BR2_ROOTFS_POST_SCRIPT_ARGS="$(BR2_EXTERNAL_ONRISC_BSP_PATH)"
BR2_LINUX_KERNEL=y
BR2_LINUX_KERNEL_CUSTOM_VERSION=y
BR2_LINUX_KERNEL_CUSTOM_VERSION_VALUE="4.8.1"
BR2_LINUX_KERNEL_USE_CUSTOM_CONFIG=y
BR2_LINUX_KERNEL_CUSTOM_CONFIG_FILE="$(BR2_EXTERNAL_ONRISC_BSP_PATH)/board/vscom/baltos/linux-4.x-config"
BR2_LINUX_KERNEL_DTS_SUPPORT=y
BR2_LINUX_KERNEL_INTREE_DTS_NAME="am335x-baltos-ir2110 am335x-baltos-ir3220 am335x-baltos-ir5221"
BR2_PACKAGE_BUSYBOX_CONFIG="$(BR2_EXTERNAL_ONRISC_BSP_PATH)/board/vscom/baltos/bb-config"
BR2_PACKAGE_BUSYBOX_SHOW_OTHERS=y
BR2_PACKAGE_MTD=y
BR2_PACKAGE_LINUX_FIRMWARE=y
BR2_PACKAGE_LINUX_FIRMWARE_RALINK_RT2XX=y
BR2_PACKAGE_LINUX_FIRMWARE_RTL_81XX=y
BR2_PACKAGE_LINUX_FIRMWARE_TI_WL18XX=y
BR2_PACKAGE_MINICOM=y
BR2_PACKAGE_USBUTILS=y
BR2_PACKAGE_PYTHON3=y
BR2_PACKAGE_PYTHON_NETIFACES=y
BR2_PACKAGE_PYTHON_SERIAL=y
BR2_PACKAGE_CAN_UTILS=y
BR2_PACKAGE_ETHTOOL=y
BR2_PACKAGE_IPROUTE2=y
BR2_PACKAGE_IW=y
BR2_PACKAGE_OPENSSH=y
BR2_PACKAGE_SER2NET=y
BR2_PACKAGE_TMUX=y
BR2_TARGET_ROOTFS_EXT2=y
BR2_TARGET_ROOTFS_EXT2_4=y
# BR2_TARGET_ROOTFS_TAR is not set
BR2_TARGET_BAREBOX=y
BR2_TARGET_BAREBOX_CUSTOM_GIT=y
BR2_TARGET_BAREBOX_CUSTOM_PATCH_DIR="$(BR2_EXTERNAL_ONRISC_BSP_PATH)/board/vscom/barebox-patches/v2016.07"
BR2_TARGET_BAREBOX_CUSTOM_GIT_REPO_URL="git://git.pengutronix.de/git/barebox.git"
BR2_TARGET_BAREBOX_CUSTOM_GIT_VERSION="22d7d604f13968fdaeadda73e81e930e933d7e10"
BR2_TARGET_BAREBOX_USE_CUSTOM_CONFIG=y
BR2_TARGET_BAREBOX_CUSTOM_CONFIG_FILE="$(BR2_EXTERNAL_ONRISC_BSP_PATH)/board/vscom/baltos/barebox/am335x_baltos_defconfig"
BR2_TARGET_BAREBOX_IMAGE_FILE="images/barebox-am33xx-baltos.img"
BR2_TARGET_BAREBOX_CUSTOM_EMBEDDED_ENV_PATH="$(BR2_EXTERNAL_ONRISC_BSP_PATH)/board/vscom/baltos/barebox/env/"
BR2_TARGET_BAREBOX_AUX=y
BR2_TARGET_BAREBOX_AUX_USE_CUSTOM_CONFIG=y
BR2_TARGET_BAREBOX_AUX_CUSTOM_CONFIG_FILE="$(BR2_EXTERNAL_ONRISC_BSP_PATH)/board/vscom/baltos/barebox/am335x_baltos_mlo_defconfig"
BR2_TARGET_BAREBOX_AUX_IMAGE_FILE="images/barebox-am33xx-baltos-mlo.img"
BR2_PACKAGE_HOST_DOSFSTOOLS=y
BR2_PACKAGE_HOST_GENIMAGE=y
BR2_PACKAGE_HOST_MTOOLS=y
BR2_PACKAGE_HOST_UBOOT_TOOLS=y
BR2_PACKAGE_HOST_UBOOT_TOOLS_FIT_SUPPORT=y
BR2_PACKAGE_LIBONRISC=y
BR2_PACKAGE_LIBONRISC_PYTHON_WRAPPER=y
```

## configs/baltos_initramfs_defconfig
```kconfig
BR2_arm=y
BR2_cortex_a8=y
BR2_TOOLCHAIN_BUILDROOT_GLIBC=y
BR2_PACKAGE_HOST_LINUX_HEADERS_CUSTOM_5_4=y
BR2_BINUTILS_VERSION_2_33_X=y
BR2_GCC_VERSION_9_X=y
BR2_TOOLCHAIN_BUILDROOT_CXX=y
BR2_GCC_ENABLE_LTO=y
BR2_ROOTFS_DEVICE_CREATION_DYNAMIC_EUDEV=y
BR2_TARGET_GENERIC_ROOT_PASSWD="linux"
BR2_ENABLE_LOCALE_WHITELIST="C"
BR2_ROOTFS_OVERLAY="$(BR2_EXTERNAL_ONRISC_BSP_PATH)/board/vscom/baltos/fs-overlay/ $(BR2_EXTERNAL_ONRISC_BSP_PATH)/board/vscom/baltos/fs-overlay-experimental/"
BR2_ROOTFS_POST_IMAGE_SCRIPT="$(BR2_EXTERNAL_ONRISC_BSP_PATH)/board/vscom/baltos/custom-FIT-intree.sh $(BR2_EXTERNAL_ONRISC_BSP_PATH)/board/vscom/scripts/modules.sh"
BR2_ROOTFS_POST_SCRIPT_ARGS="$(BR2_EXTERNAL_ONRISC_BSP_PATH)"
BR2_LINUX_KERNEL=y
BR2_LINUX_KERNEL_CUSTOM_VERSION=y
BR2_LINUX_KERNEL_CUSTOM_VERSION_VALUE="5.4.30"
BR2_LINUX_KERNEL_PATCH="$(BR2_EXTERNAL_ONRISC_BSP_PATH)/board/vscom/kernel-patches/upstream"
BR2_LINUX_KERNEL_USE_CUSTOM_CONFIG=y
BR2_LINUX_KERNEL_CUSTOM_CONFIG_FILE="$(BR2_EXTERNAL_ONRISC_BSP_PATH)/board/vscom/baltos/linux-4.x-config"
BR2_LINUX_KERNEL_DTS_SUPPORT=y
BR2_LINUX_KERNEL_INTREE_DTS_NAME="am335x-baltos-ir2110 am335x-baltos-ir3220 am335x-baltos-ir5221 am335x-netcan-plus-1xx am335x-netcom-plus-2xx am335x-netcom-plus-8xx"
BR2_PACKAGE_BUSYBOX_CONFIG="$(BR2_EXTERNAL_ONRISC_BSP_PATH)/board/vscom/baltos/bb-config"
BR2_PACKAGE_BUSYBOX_SHOW_OTHERS=y
BR2_PACKAGE_MTD=y
BR2_PACKAGE_LINUX_FIRMWARE=y
BR2_PACKAGE_LINUX_FIRMWARE_RALINK_RT2XX=y
BR2_PACKAGE_LINUX_FIRMWARE_RTL_81XX=y
BR2_PACKAGE_LINUX_FIRMWARE_TI_WL18XX=y
BR2_PACKAGE_USBUTILS=y
BR2_PACKAGE_ZLIB=y
BR2_PACKAGE_CAN_UTILS=y
BR2_PACKAGE_DROPBEAR=y
BR2_PACKAGE_ETHTOOL=y
BR2_PACKAGE_IPROUTE2=y
BR2_PACKAGE_IW=y
BR2_PACKAGE_SER2NET=y
BR2_TARGET_ROOTFS_INITRAMFS=y
# BR2_TARGET_ROOTFS_TAR is not set
BR2_TARGET_BAREBOX=y
BR2_TARGET_BAREBOX_CUSTOM_GIT=y
BR2_TARGET_BAREBOX_CUSTOM_GIT_REPO_URL="git://git.pengutronix.de/git/barebox.git"
BR2_TARGET_BAREBOX_CUSTOM_GIT_VERSION="6c42b62fceb042b4bc1c046c086962de4ce92c94"
BR2_TARGET_BAREBOX_USE_CUSTOM_CONFIG=y
BR2_TARGET_BAREBOX_CUSTOM_CONFIG_FILE="$(BR2_EXTERNAL_ONRISC_BSP_PATH)/board/vscom/baltos/barebox/am335x_baltos_defconfig"
BR2_TARGET_BAREBOX_IMAGE_FILE="images/barebox-am33xx-baltos.img"
BR2_TARGET_BAREBOX_CUSTOM_EMBEDDED_ENV_PATH="$(BR2_EXTERNAL_ONRISC_BSP_PATH)/board/vscom/baltos/barebox/env/"
BR2_TARGET_BAREBOX_AUX=y
BR2_TARGET_BAREBOX_AUX_USE_CUSTOM_CONFIG=y
BR2_TARGET_BAREBOX_AUX_CUSTOM_CONFIG_FILE="$(BR2_EXTERNAL_ONRISC_BSP_PATH)/board/vscom/baltos/barebox/am335x_baltos_mlo_defconfig"
BR2_TARGET_BAREBOX_AUX_IMAGE_FILE="images/barebox-am33xx-baltos-mlo.img"
BR2_PACKAGE_HOST_UBOOT_TOOLS=y
BR2_PACKAGE_HOST_UBOOT_TOOLS_FIT_SUPPORT=y
BR2_PACKAGE_LIBONRISC=y
```

## package/libonrisc/Config.in
```kconfig
config BR2_PACKAGE_LIBONRISC
	bool "libonrisc"
	select BR2_PACKAGE_LIBSOC
	depends on BR2_TOOLCHAIN_HAS_THREADS
	depends on BR2_PACKAGE_HAS_UDEV
	help
	  OnRISC hardware API

comment "libonrisc requires a toolchain with threads support and libudev"
	depends on !BR2_TOOLCHAIN_HAS_THREADS || !BR2_PACKAGE_HAS_UDEV
```

## package/node-red-contrib-libonrisc/Config.in
```kconfig
config BR2_PACKAGE_NODE_RED_CONTRIB_LIBONRISC
	bool "node-red-contrib-libonrisc"
	select BR2_PACKAGE_LIBONRISC
	depends on BR2_PACKAGE_NODEJS
	depends on BR2_TOOLCHAIN_HAS_THREADS
	depends on BR2_PACKAGE_HAS_UDEV
	help
	  Node-RED module for libonrisc library.

comment "node-red-contrib-libonrisc requires a toolchain with threads support, nodejs and libudev"
	depends on !BR2_TOOLCHAIN_HAS_THREADS || !BR2_PACKAGE_HAS_UDEV || !BR2_PACKAGE_NODEJS
```

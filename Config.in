## Config.in
```kconfig
source "$BR2_EXTERNAL_ONRISC_BSP_PATH/package/libonrisc/Config.in"
source "$BR2_EXTERNAL_ONRISC_BSP_PATH/package/node-red-contrib-libonrisc/Config.in"
```

## board/vscom/baltos/barebox/am335x_baltos_mlo_defconfig
```kconfig
CONFIG_ARCH_OMAP_MULTI=y
CONFIG_OMAP_BUILD_IFT=y
CONFIG_MACH_VSCOM_BALTOS=y
CONFIG_THUMB2_BAREBOX=y
# CONFIG_MEMINFO is not set
CONFIG_MMU=y
CONFIG_BAREBOX_MAX_IMAGE_SIZE=0x1b400
CONFIG_MALLOC_SIZE=0x0
CONFIG_MALLOC_TLSF=y
CONFIG_RELOCATABLE=y
CONFIG_PROMPT="MLO>"
CONFIG_SHELL_NONE=y
# CONFIG_ERRNO_MESSAGES is not set
# CONFIG_TIMESTAMP is not set
CONFIG_CONSOLE_NONE=y
# CONFIG_CONSOLE_DISABLE_INPUT is not set
CONFIG_OFDEVICE=y
# CONFIG_SPI is not set
CONFIG_MTD=y
# CONFIG_MTD_WRITE is not set
# CONFIG_MTD_OOB_DEVICE is not set
CONFIG_NAND=y
CONFIG_NAND_OMAP_GPMC=y
CONFIG_MCI=y
# CONFIG_MCI_WRITE is not set
CONFIG_MCI_OMAP_HSMMC=y
# CONFIG_PINCTRL is not set
CONFIG_BUS_OMAP_GPMC=y
# CONFIG_VIRTIO_MENU is not set
# CONFIG_FS_RAMFS is not set
# CONFIG_FS_DEVFS is not set
CONFIG_FS_FAT=y
CONFIG_FS_FAT_LFN=y
```

## board/vscom/baltos/kernel-fit-intree-4.9.its
```
/*
 * Simple U-boot uImage source file containing a single kernel and FDT blob
 */

/dts-v1/;

/ {
	description = "Simple image with single Linux kernel and FDT blob";
	#address-cells = <1>;

	images {
		kernel@1 {
			description = "Vanilla Linux kernel";
			data = /incbin/("zImage");
			type = "kernel";
			arch = "arm";
			os = "linux";
			compression = "none";
			load = <0x80200000>;
			entry = <0x80200000>;
			hash@1 {
				algo = "crc32";
			};
			hash@2 {
				algo = "sha1";
			};
		};
		fdt210@1 {
			description = "Flattened Device Tree blob (210)";
			data = /incbin/("am335x-baltos-ir5221.dtb");
			type = "flat_dt";
			arch = "arm";
			compression = "none";
			hash@1 {
				algo = "crc32";
			};
			hash@2 {
				algo = "sha1";
			};
		};
		fdt211@1 {
			description = "Flattened Device Tree blob (211)";
			data = /incbin/("am335x-baltos-ir3220.dtb");
			type = "flat_dt";
			arch = "arm";
			compression = "none";
			hash@1 {
				algo = "crc32";
			};
			hash@2 {
				algo = "sha1";
			};
		};
		fdt212@1 {
			description = "Flattened Device Tree blob (212)";
			data = /incbin/("am335x-baltos-ir2110.dtb");
			type = "flat_dt";
			arch = "arm";
			compression = "none";
			hash@1 {
				algo = "crc32";
			};
			hash@2 {
				algo = "sha1";
			};
		};
	};

	configurations {
		default = "conf210@1";
		conf210@1 {
			description = "Boot Linux kernel with FDT blob (210)";
			kernel = "kernel@1";
			fdt = "fdt210@1";
		};
		conf211@1 {
			description = "Boot Linux kernel with FDT blob (211)";
			kernel = "kernel@1";
			fdt = "fdt211@1";
		};
		conf212@1 {
			description = "Boot Linux kernel with FDT blob (212)";
			kernel = "kernel@1";
			fdt = "fdt212@1";
		};
	};
};
```

## board/vscom/baltos/kernel-fit.its
```
/*
 * Simple U-boot uImage source file containing a single kernel and FDT blob
 */

/dts-v1/;

/ {
	description = "Simple image with single Linux kernel and FDT blob";
	#address-cells = <1>;

	images {
		kernel@1 {
			description = "Vanilla Linux kernel";
			data = /incbin/("zImage");
			type = "kernel";
			arch = "arm";
			os = "linux";
			compression = "none";
			load = <0x80200000>;
			entry = <0x80200000>;
			hash@1 {
				algo = "crc32";
			};
			hash@2 {
				algo = "sha1";
			};
		};
		fdt210@1 {
			description = "Flattened Device Tree blob (210)";
			data = /incbin/("onrisc-baltos-ir-5221.dtb");
			type = "flat_dt";
			arch = "arm";
			compression = "none";
			hash@1 {
				algo = "crc32";
			};
			hash@2 {
				algo = "sha1";
			};
		};
		fdt211@1 {
			description = "Flattened Device Tree blob (211)";
			data = /incbin/("onrisc-baltos-ir-3220.dtb");
			type = "flat_dt";
			arch = "arm";
			compression = "none";
			hash@1 {
				algo = "crc32";
			};
			hash@2 {
				algo = "sha1";
			};
		};
		fdt212@1 {
			description = "Flattened Device Tree blob (212)";
			data = /incbin/("onrisc-baltos-ir-2110.dtb");
			type = "flat_dt";
			arch = "arm";
			compression = "none";
			hash@1 {
				algo = "crc32";
			};
			hash@2 {
				algo = "sha1";
			};
		};
		fdt220@1 {
			description = "Flattened Device Tree blob (220)";
			data = /incbin/("netcom-plus.dtb");
			type = "flat_dt";
			arch = "arm";
			compression = "none";
			hash@1 {
				algo = "crc32";
			};
			hash@2 {
				algo = "sha1";
			};
		};
		fdt224@1 {
			description = "Flattened Device Tree blob (220)";
			data = /incbin/("netcom-plus-omap-uarts.dtb");
			type = "flat_dt";
			arch = "arm";
			compression = "none";
			hash@1 {
				algo = "crc32";
			};
			hash@2 {
				algo = "sha1";
			};
		};
		fdt230@1 {
			description = "Flattened Device Tree blob (230)";
			data = /incbin/("netcan.dtb");
			type = "flat_dt";
			arch = "arm";
			compression = "none";
			hash@1 {
				algo = "crc32";
			};
			hash@2 {
				algo = "sha1";
			};
		};
	};

	configurations {
		default = "conf210@1";
		conf210@1 {
			description = "Boot Linux kernel with FDT blob (210)";
			kernel = "kernel@1";
			fdt = "fdt210@1";
		};
		conf211@1 {
			description = "Boot Linux kernel with FDT blob (211)";
			kernel = "kernel@1";
			fdt = "fdt211@1";
		};
		conf212@1 {
			description = "Boot Linux kernel with FDT blob (212)";
			kernel = "kernel@1";
			fdt = "fdt212@1";
		};
		conf214@1 {
			description = "Boot Linux kernel with FDT blob (214)";
			kernel = "kernel@1";
			fdt = "fdt220@1";
		};
		conf215@1 {
			description = "Boot Linux kernel with FDT blob (215)";
			kernel = "kernel@1";
			fdt = "fdt220@1";
		};
		conf220@1 {
			description = "Boot Linux kernel with FDT blob (220)";
			kernel = "kernel@1";
			fdt = "fdt220@1";
		};
		conf221@1 {
			description = "Boot Linux kernel with FDT blob (221)";
			kernel = "kernel@1";
			fdt = "fdt220@1";
		};
		conf222@1 {
			description = "Boot Linux kernel with FDT blob (222)";
			kernel = "kernel@1";
			fdt = "fdt220@1";
		};
		conf223@1 {
			description = "Boot Linux kernel with FDT blob (223)";
			kernel = "kernel@1";
			fdt = "fdt220@1";
		};
		conf224@1 {
			description = "Boot Linux kernel with FDT blob (224)";
			kernel = "kernel@1";
			fdt = "fdt224@1";
		};
		conf225@1 {
			description = "Boot Linux kernel with FDT blob (225)";
			kernel = "kernel@1";
			fdt = "fdt224@1";
		};
		conf226@1 {
			description = "Boot Linux kernel with FDT blob (226)";
			kernel = "kernel@1";
			fdt = "fdt224@1";
		};
		conf227@1 {
			description = "Boot Linux kernel with FDT blob (227)";
			kernel = "kernel@1";
			fdt = "fdt224@1";
		};
		conf230@1 {
			description = "Boot Linux kernel with FDT blob (230)";
			kernel = "kernel@1";
			fdt = "fdt230@1";
		};
	};
};
```

## configs/alekto2_defconfig
```kconfig
BR2_arm=y
BR2_cortex_a8=y
BR2_ARM_SOFT_FLOAT=y
BR2_JLEVEL=24
BR2_CCACHE=y
BR2_PACKAGE_OVERRIDE_FILE="$(BR2_EXTERNAL)/local.mk"
BR2_TOOLCHAIN_EXTERNAL=y
BR2_ENABLE_LOCALE_PURGE=y
BR2_ENABLE_LOCALE_WHITELIST="C"
BR2_ROOTFS_DEVICE_CREATION_DYNAMIC_EUDEV=y
BR2_TARGET_GENERIC_ROOT_PASSWD="linux"
BR2_TARGET_GENERIC_GETTY_PORT="ttyO3"
BR2_ROOTFS_POST_IMAGE_SCRIPT="$(BR2_EXTERNAL)/board/vscom/scripts/modules.sh"
BR2_LINUX_KERNEL=y
BR2_LINUX_KERNEL_CUSTOM_TARBALL=y
BR2_LINUX_KERNEL_CUSTOM_TARBALL_LOCATION="https://www.kernel.org/pub/linux/kernel/v3.x/testing/linux-3.18-rc3.tar.xz"
BR2_LINUX_KERNEL_PATCH="$(BR2_EXTERNAL)/board/vscom/kernel-patches/linux-3.18"
BR2_LINUX_KERNEL_USE_CUSTOM_CONFIG=y
BR2_LINUX_KERNEL_CUSTOM_CONFIG_FILE="$(BR2_EXTERNAL)/board/vscom/alekto2/linux-3.18-config"
BR2_LINUX_KERNEL_UIMAGE_LOADADDR="0x81000000"
BR2_LINUX_KERNEL_DTS_SUPPORT=y
BR2_LINUX_KERNEL_USE_CUSTOM_DTS=y
BR2_LINUX_KERNEL_CUSTOM_DTS_PATH="$(BR2_EXTERNAL)/board/vscom/alekto2/onrisc-alekto2.dts"
BR2_PACKAGE_BUSYBOX_CONFIG="$(BR2_EXTERNAL)/board/vscom/balios/bb-config"
BR2_PACKAGE_BUSYBOX_SHOW_OTHERS=y
BR2_PACKAGE_MTD=y
BR2_PACKAGE_LINUX_FIRMWARE=y
BR2_PACKAGE_LINUX_FIRMWARE_TI_WL127X=y
BR2_PACKAGE_USBUTILS=y
BR2_PACKAGE_USBUTILS_ZLIB=y
BR2_PACKAGE_PYTHON=y
BR2_PACKAGE_PYTHON_NETIFACES=y
BR2_PACKAGE_PYTHON_SERIAL=y
BR2_PACKAGE_CAN_UTILS=y
BR2_PACKAGE_IPROUTE2=y
BR2_PACKAGE_IW=y
BR2_PACKAGE_OPENSSH=y
BR2_PACKAGE_SER2NET=y
BR2_TARGET_ROOTFS_TAR_BZIP2=y
BR2_PACKAGE_HOST_UBOOT_TOOLS=y
BR2_PACKAGE_LIBONRISC=y
```

## configs/balios_defconfig
```kconfig
BR2_arm=y
BR2_cortex_a8=y
BR2_JLEVEL=24
BR2_CCACHE=y
BR2_TOOLCHAIN_BUILDROOT_WCHAR=y
BR2_ENABLE_LOCALE_PURGE=y
BR2_ENABLE_LOCALE_WHITELIST="C"
BR2_TARGET_GENERIC_GETTY_PORT="ttyO0"
BR2_ROOTFS_OVERLAY="$(BR2_EXTERNAL)/board/vscom/balios/fs-overlay"
BR2_LINUX_KERNEL=y
BR2_LINUX_KERNEL_USE_CUSTOM_CONFIG=y
BR2_LINUX_KERNEL_CUSTOM_CONFIG_FILE="$(BR2_EXTERNAL)/board/vscom/balios/linux-3.15-config"
BR2_LINUX_KERNEL_ZIMAGE=y
BR2_LINUX_KERNEL_DTS_SUPPORT=y
BR2_LINUX_KERNEL_USE_CUSTOM_DTS=y
BR2_LINUX_KERNEL_CUSTOM_DTS_PATH="$(BR2_EXTERNAL)/board/vscom/balios/onrisc-balios-ir-5221.dts"
BR2_PACKAGE_MTD=y
BR2_PACKAGE_PYTHON3=y
BR2_TARGET_ROOTFS_CPIO_XZ=y
BR2_TARGET_ROOTFS_INITRAMFS=y
# BR2_TARGET_ROOTFS_TAR is not set
BR2_PACKAGE_LIBONRISC=y
```

## configs/baltos_barebox_defconfig
```kconfig
BR2_arm=y
BR2_cortex_a8=y
BR2_KERNEL_MIRROR="https://www.kernel.org/pub"
BR2_GNU_MIRROR="http://ftp.gnu.org/pub/gnu"
# BR2_COMPILER_PARANOID_UNSAFE_PATH is not set
BR2_TOOLCHAIN_EXTERNAL=y
BR2_ROOTFS_DEVICE_CREATION_DYNAMIC_EUDEV=y
BR2_TARGET_GENERIC_ROOT_PASSWD="linux"
BR2_ENABLE_LOCALE_WHITELIST="C"
BR2_GENERATE_LOCALE="en_US"
BR2_ROOTFS_OVERLAY="$(BR2_EXTERNAL_ONRISC_BSP_PATH)/board/vscom/baltos/fs-overlay/ $(BR2_EXTERNAL_ONRISC_BSP_PATH)/board/vscom/baltos/fs-overlay-experimental/"
BR2_ROOTFS_POST_BUILD_SCRIPT="$(BR2_EXTERNAL_ONRISC_BSP_PATH)/board/vscom/baltos/custom-FIT-intree.sh"
BR2_ROOTFS_POST_IMAGE_SCRIPT="$(BR2_EXTERNAL_ONRISC_BSP_PATH)/board/vscom/scripts/modules.sh $(BR2_EXTERNAL_ONRISC_BSP_PATH)/board/vscom/baltos/post-image-barebox.sh"
BR2_ROOTFS_POST_SCRIPT_ARGS="$(BR2_EXTERNAL_ONRISC_BSP_PATH)"
BR2_LINUX_KERNEL=y
BR2_LINUX_KERNEL_CUSTOM_VERSION=y
BR2_LINUX_KERNEL_CUSTOM_VERSION_VALUE="5.4.15"
BR2_LINUX_KERNEL_PATCH="$(BR2_EXTERNAL_ONRISC_BSP_PATH)/board/vscom/kernel-patches/upstream"
BR2_LINUX_KERNEL_USE_CUSTOM_CONFIG=y
BR2_LINUX_KERNEL_CUSTOM_CONFIG_FILE="$(BR2_EXTERNAL_ONRISC_BSP_PATH)/board/vscom/baltos/linux-4.x-config"
BR2_LINUX_KERNEL_DTS_SUPPORT=y
BR2_LINUX_KERNEL_INTREE_DTS_NAME="am335x-baltos-ir2110 am335x-baltos-ir3220 am335x-baltos-ir5221 am335x-netcan-plus-1xx am335x-netcom-plus-2xx am335x-netcom-plus-8xx"
BR2_PACKAGE_BUSYBOX_CONFIG="$(BR2_EXTERNAL_ONRISC_BSP_PATH)/board/vscom/baltos/bb-config"
BR2_PACKAGE_BUSYBOX_SHOW_OTHERS=y
BR2_PACKAGE_MTD=y
BR2_PACKAGE_LINUX_FIRMWARE=y
BR2_PACKAGE_LINUX_FIRMWARE_RALINK_RT2XX=y
BR2_PACKAGE_LINUX_FIRMWARE_RTL_81XX=y
BR2_PACKAGE_LINUX_FIRMWARE_TI_WL18XX=y
BR2_PACKAGE_MINICOM=y
BR2_PACKAGE_USBUTILS=y
BR2_PACKAGE_PYTHON3=y
BR2_PACKAGE_PYTHON3_ZLIB=y
BR2_PACKAGE_PYTHON_NETIFACES=y
BR2_PACKAGE_PYTHON_SERIAL=y
BR2_PACKAGE_CAN_UTILS=y
BR2_PACKAGE_DROPBEAR=y
BR2_PACKAGE_ETHTOOL=y
BR2_PACKAGE_IPROUTE2=y
BR2_PACKAGE_IW=y
BR2_PACKAGE_SER2NET=y
BR2_PACKAGE_TMUX=y
BR2_TARGET_ROOTFS_EXT2=y
BR2_TARGET_ROOTFS_EXT2_4=y
BR2_TARGET_ROOTFS_EXT2_SIZE="200M"
BR2_TARGET_ROOTFS_SQUASHFS=y
BR2_TARGET_ROOTFS_SQUASHFS4_XZ=y
BR2_TARGET_ROOTFS_TAR_BZIP2=y
BR2_TARGET_ROOTFS_UBIFS=y
BR2_TARGET_BAREBOX=y
BR2_TARGET_BAREBOX_CUSTOM_VERSION=y
BR2_TARGET_BAREBOX_CUSTOM_VERSION_VALUE="2018.02.0"
BR2_TARGET_BAREBOX_USE_CUSTOM_CONFIG=y
BR2_TARGET_BAREBOX_CUSTOM_CONFIG_FILE="$(BR2_EXTERNAL_ONRISC_BSP_PATH)/board/vscom/baltos/barebox/am335x_baltos_defconfig"
BR2_TARGET_BAREBOX_IMAGE_FILE="images/barebox-am33xx-baltos.img"
BR2_TARGET_BAREBOX_CUSTOM_EMBEDDED_ENV_PATH="$(BR2_EXTERNAL_ONRISC_BSP_PATH)/board/vscom/baltos/barebox/env/"
BR2_TARGET_BAREBOX_AUX=y
BR2_TARGET_BAREBOX_AUX_USE_CUSTOM_CONFIG=y
BR2_TARGET_BAREBOX_AUX_CUSTOM_CONFIG_FILE="$(BR2_EXTERNAL_ONRISC_BSP_PATH)/board/vscom/baltos/barebox/am335x_baltos_mlo_defconfig"
BR2_TARGET_BAREBOX_AUX_IMAGE_FILE="images/barebox-am33xx-baltos-mlo.img"
BR2_PACKAGE_HOST_DOSFSTOOLS=y
BR2_PACKAGE_HOST_GENIMAGE=y
BR2_PACKAGE_HOST_MTOOLS=y
BR2_PACKAGE_HOST_UBOOT_TOOLS=y
BR2_PACKAGE_HOST_UBOOT_TOOLS_FIT_SUPPORT=y
BR2_PACKAGE_LIBONRISC=y
```

## configs/baltos_defconfig
```kconfig
BR2_arm=y
BR2_cortex_a8=y
BR2_ARM_EABI=y
BR2_ARM_SOFT_FLOAT=y
BR2_TOOLCHAIN_BUILDROOT_GLIBC=y
BR2_PACKAGE_HOST_LINUX_HEADERS_CUSTOM_5_4=y
BR2_BINUTILS_VERSION_2_35_X=y
BR2_TOOLCHAIN_BUILDROOT_CXX=y
BR2_GCC_ENABLE_LTO=y
BR2_GCC_ENABLE_OPENMP=y
BR2_GCC_ENABLE_GRAPHITE=y
BR2_ROOTFS_DEVICE_CREATION_DYNAMIC_EUDEV=y
BR2_TARGET_GENERIC_ROOT_PASSWD="linux"
BR2_ENABLE_LOCALE_WHITELIST="C"
BR2_GENERATE_LOCALE="en_US"
BR2_ROOTFS_OVERLAY="$(BR2_EXTERNAL_ONRISC_BSP_PATH)/board/vscom/baltos/fs-overlay/"
BR2_ROOTFS_POST_IMAGE_SCRIPT="$(BR2_EXTERNAL_ONRISC_BSP_PATH)/board/vscom/baltos/custom-FIT-intree.sh $(BR2_EXTERNAL_ONRISC_BSP_PATH)/board/vscom/scripts/modules.sh $(BR2_EXTERNAL_ONRISC_BSP_PATH)/board/vscom/baltos/post-image.sh"
BR2_ROOTFS_POST_SCRIPT_ARGS="$(BR2_EXTERNAL_ONRISC_BSP_PATH)"
BR2_LINUX_KERNEL=y
BR2_LINUX_KERNEL_CUSTOM_VERSION=y
BR2_LINUX_KERNEL_CUSTOM_VERSION_VALUE="5.4.61"
BR2_LINUX_KERNEL_PATCH="$(BR2_EXTERNAL_ONRISC_BSP_PATH)/board/vscom/kernel-patches/upstream"
BR2_LINUX_KERNEL_USE_CUSTOM_CONFIG=y
BR2_LINUX_KERNEL_CUSTOM_CONFIG_FILE="$(BR2_EXTERNAL_ONRISC_BSP_PATH)/board/vscom/baltos/linux-4.x-config"
BR2_LINUX_KERNEL_DTS_SUPPORT=y
BR2_LINUX_KERNEL_INTREE_DTS_NAME="am335x-baltos-ir2110 am335x-baltos-ir3220 am335x-baltos-ir5221 am335x-netcan-plus-1xx am335x-netcom-plus-2xx am335x-netcom-plus-8xx"
BR2_PACKAGE_BUSYBOX_CONFIG="$(BR2_EXTERNAL_ONRISC_BSP_PATH)/board/vscom/baltos/bb-config"
BR2_PACKAGE_BUSYBOX_SHOW_OTHERS=y
BR2_PACKAGE_GETTEXT=y
BR2_PACKAGE_MTD=y
BR2_PACKAGE_LINUX_FIRMWARE=y
BR2_PACKAGE_LINUX_FIRMWARE_RALINK_RT2XX=y
BR2_PACKAGE_LINUX_FIRMWARE_RTL_81XX=y
BR2_PACKAGE_LINUX_FIRMWARE_TI_WL18XX=y
BR2_PACKAGE_MINICOM=y
BR2_PACKAGE_USBUTILS=y
BR2_PACKAGE_PYTHON3=y
BR2_PACKAGE_PYTHON3_READLINE=y
BR2_PACKAGE_PYTHON3_ZLIB=y
BR2_PACKAGE_PYTHON_NETIFACES=y
BR2_PACKAGE_PYTHON_SERIAL=y
BR2_PACKAGE_CAN_UTILS=y
BR2_PACKAGE_DROPBEAR=y
BR2_PACKAGE_ETHTOOL=y
BR2_PACKAGE_IPROUTE2=y
BR2_PACKAGE_IW=y
BR2_PACKAGE_SER2NET=y
BR2_PACKAGE_TMUX=y
BR2_TARGET_ROOTFS_EXT2=y
BR2_TARGET_ROOTFS_EXT2_4=y
BR2_TARGET_ROOTFS_EXT2_SIZE="160M"
BR2_TARGET_ROOTFS_EXT2_RESBLKS=0
BR2_TARGET_ROOTFS_TAR_BZIP2=y
BR2_TARGET_UBOOT=y
BR2_TARGET_UBOOT_BUILD_SYSTEM_KCONFIG=y
BR2_TARGET_UBOOT_CUSTOM_VERSION=y
BR2_TARGET_UBOOT_CUSTOM_VERSION_VALUE="2017.11"
BR2_TARGET_UBOOT_PATCH="$(BR2_EXTERNAL_ONRISC_BSP_PATH)/board/vscom/u-boot-patches/2017.11"
BR2_TARGET_UBOOT_USE_CUSTOM_CONFIG=y
BR2_TARGET_UBOOT_CUSTOM_CONFIG_FILE="$(BR2_EXTERNAL_ONRISC_BSP_PATH)/board/vscom/baltos/u-boot-2048-nand-config"
BR2_TARGET_UBOOT_FORMAT_IMG=y
BR2_TARGET_UBOOT_SPL=y
BR2_TARGET_UBOOT_SPL_NAME="MLO"
BR2_PACKAGE_HOST_DOSFSTOOLS=y
BR2_PACKAGE_HOST_GENEXT2FS=y
BR2_PACKAGE_HOST_GENIMAGE=y
BR2_PACKAGE_HOST_MTOOLS=y
BR2_PACKAGE_HOST_UBOOT_TOOLS=y
BR2_PACKAGE_HOST_UBOOT_TOOLS_FIT_SUPPORT=y
BR2_PACKAGE_LIBONRISC=y
```
